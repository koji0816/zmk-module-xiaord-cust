## src/display/Kconfig
```kconfig
choice XIAORD_BG
    prompt "Background image"
    default XIAORD_BG_1

config XIAORD_BG_1
    bool "Background 1"

config XIAORD_BG_2
    bool "Background 2"

config XIAORD_BG_3
    bool "Background 3"

endchoice

config XIAORD_BACKLIGHT_BRIGHTNESS
	int "Display backlight brightness percent"
	range 0 100
	default 60
	help
	  Backlight PWM duty cycle in percent for the XIAO Round Display.
	  Set to 60 for a dimmer screen than the hardware default.
```
